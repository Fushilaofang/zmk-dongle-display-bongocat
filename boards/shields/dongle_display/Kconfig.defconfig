## boards/shields/dongle_display/Kconfig.defconfig
```kconfig
# Copyright (c) 2024 The ZMK Contributors
# SPDX-License-Identifier: MIT

if SHIELD_DONGLE_DISPLAY

choice ZMK_DISPLAY_STATUS_SCREEN
    default ZMK_DISPLAY_STATUS_SCREEN_CUSTOM
endchoice

config ZMK_DISPLAY_STATUS_SCREEN_CUSTOM
    select LV_USE_LABEL
    select LV_USE_IMAGE
    select LV_USE_CANVAS
    select LV_USE_ANIMIMG 
    select LV_USE_ANIMATION
    select LV_USE_LINE 
    select LV_FONT_UNSCII_8
    select ZMK_WPM
    imply ZMK_HID_INDICATORS

config DISPLAY
	default y

config ST730X
	bool "ST730x display controllers driver"
	default y
	depends on DT_HAS_SITRONIX_ST7305_ENABLED || DT_HAS_SITRONIX_ST7306_ENABLED
	select MIPI_DBI
	help
	  Enable driver for ST730X series display controllers.

config ST730X_CONV_BUFFER_LINE_CNT
	int "Size of the conversion buffer in lines"
	default 8
	range 1 1024
	help
	  Size of the conversion buffer in lines.

# 根据需要选择功耗模式
config ST730X_POWERMODE_LOW
    bool "Use low power mode"
  	default n
  	help
  	  Enable this to use lower framerate LPM (Low Power Mode).

config SPI
	default y

config ZMK_DONGLE_DISPLAY_DONGLE_BATTERY
    bool "Show also the battery level of the dongle"
    depends on BT && (!ZMK_SPLIT_BLE || ZMK_SPLIT_ROLE_CENTRAL)

config ZMK_BATTERY
    bool "Show the battery level of the device"
    default y

config ZMK_DONGLE_DISPLAY_MAC_MODIFIERS
    bool "Use MacOS modifier symbols instead of the Windows symbols"

config ZMK_DONGLE_DISPLAY_BONGO_CAT
    bool "Display the Bongo Cat widget"
    default y

config ZMK_DONGLE_DISPLAY_MODIFIERS
    bool "Display the modifiers widget"
    default y

config ZMK_DONGLE_DISPLAY_LAYER
    bool "Display the highest layer widget"
    default y

choice ZMK_DISPLAY_WORK_QUEUE
    default ZMK_DISPLAY_WORK_QUEUE_DEDICATED
endchoice

config LV_Z_MEM_POOL_SIZE
    default 8192

config LV_Z_VDB_SIZE
    default 64

config LV_Z_DOUBLE_VDB
	default n

config LV_DPI_DEF
    default 148

config LV_Z_BITS_PER_PIXEL
    default 1

choice LV_COLOR_DEPTH
    default LV_COLOR_DEPTH_1
endchoice

endif
```

## config/west.yml
```yaml
manifest:
  remotes:
    - name: petejohanson
      url-base: https://github.com/petejohanson
  projects:
    - name: zmk
      remote: petejohanson
      revision: core/move-to-zephyr-4-1
      import: app/west.yml
  self:
    path: config
```
